// Generated by web/build_standalone.py; edit web sources instead.
#pragma once
const char PAGE[] PROGMEM = R"HTML(<!doctype html>
<html lang="en"><head><script>window.FG_DEVICE_PAGE=true;</script><meta charset="utf-8"><meta name="viewport" content="width=device-width,initial-scale=1">
<title>ESP32 Function Generator</title><style>
body{font:16px system-ui;margin:0;background:#eef2f7;color:#192638}main{max-width:1100px;margin:auto;padding:24px}h1{margin-bottom:8px}.grid{display:grid;grid-template-columns:repeat(auto-fit,minmax(300px,1fr));gap:16px}form{background:white;border:1px solid #d2dae5;border-radius:12px;padding:20px}label{display:flex;align-items:center;justify-content:space-between;gap:12px;margin:16px 0}input[type=number],select{width:130px;padding:7px;border:1px solid #9cabbf;border-radius:5px}button{background:#245cad;color:white;border:0;border-radius:6px;padding:10px 14px;cursor:pointer;margin:4px 0}button.stop{background:#b32d37}button:disabled{opacity:.5}small{display:block;line-height:1.5;color:#506078}.pins{font-weight:600}.actual{background:#f1f5fa;padding:12px;border-radius:6px;line-height:1.6}.badge{font-size:14px;font-weight:bold}#status{min-height:24px;margin:18px 0}[hidden]{display:none!important}.mapping{padding:12px;background:#fff3d5;border-radius:6px}
.connection,.network{background:white;border:1px solid #d2dae5;border-radius:12px;padding:20px;margin:20px 0}
.toolbar{display:flex;align-items:center;gap:12px;flex-wrap:wrap}.toolbar h2{margin:0;flex:1}.toolbar a{color:#245cad}
.pill{background:#eef2f7;color:#506078;border-radius:20px;padding:6px 12px;font-size:14px;font-weight:600}
.pill.connected{background:#e0f2ea;color:#166c4e}button.secondary{background:#e8eef7;color:#245cad}
button:hover:enabled{filter:brightness(.93)}button:focus-visible,a:focus-visible,summary:focus-visible{outline:3px solid #7ca9ed;outline-offset:3px}
#status{margin:12px 0 0;overflow-wrap:anywhere}#networkStatus{white-space:pre-line;overflow-wrap:anywhere;margin-bottom:10px}
details{border-top:1px solid #e0e6ee;padding-top:14px}summary{cursor:pointer;color:#245cad;font-weight:600}
.network form{padding:0;border:0;margin-top:16px}.network-grid{display:grid;grid-template-columns:repeat(2,minmax(0,1fr));gap:0 24px}
.network input[type=text],.network input[type=password]{width:200px;max-width:55%;box-sizing:border-box;padding:8px;border:1px solid #9cabbf;border-radius:5px}
.network fieldset{margin:12px 0;padding:0;border:0}.network fieldset label{margin:12px 0}.network legend{font-weight:600;padding-top:8px}
#networkFeedback{min-height:24px;color:#506078}#empty{padding:24px;border:1px dashed #aebccd;border-radius:12px;text-align:center;color:#506078}
form[data-dirty="1"]{border-color:#d1a33d}form[data-dirty="1"] .feedback{color:#936410}.feedback{min-height:24px}
input:disabled,select:disabled{background:#f0f3f7;color:#8490a0}.badge{white-space:nowrap}.off{opacity:.75}
#unsupported{background:#fff3d5;padding:14px;border-radius:8px}#networkEdit[disabled]{opacity:.65}
@media(max-width:650px){main{padding:16px}.network-grid{grid-template-columns:1fr}.grid{grid-template-columns:1fr}.toolbar{gap:8px}h1{font-size:27px}}

</style><link rel="icon" href="data:,"></head>
<body><main><h1>ESP32 Function Generator</h1><p>Three independent high/low pairs · Two selectable waveform outputs</p>
<section class="connection" aria-label="Device connection">
<div class="toolbar"><label>Connection<select id="connectionMode"><option value="serial">USB serial</option><option value="http">Wi-Fi / HTTP</option></select></label><label id="deviceAddressLabel" hidden>ESP32 address<input id="deviceAddress" placeholder="http://192.168.1.50"></label><button id="connect">Connect</button><button id="disconnect" class="secondary" disabled>Disconnect</button><span id="connectionBadge" class="pill">Not connected</span><span>USB: 115200 baud · Wi-Fi: HTTP</span><a href="#channels">Outputs</a><a href="#network">Wi-Fi &amp; IP</a><button class="stop" id="stopAll" disabled>Stop all outputs</button></div>
<p id="status" role="status" aria-live="polite">Choose USB serial or enter the ESP32 HTTP address to read its settings. Close Serial Monitor and the Python GUI first.</p>
<p id="unsupported" hidden>USB serial is unavailable here. Open this HTML file in desktop Chrome or Edge. If USB access is blocked by your browser, serve the page through localhost or HTTPS.</p>
</section>
<section class="network" id="network" aria-label="Wi-Fi and IP settings">
<div class="toolbar"><h2>Wi-Fi &amp; IP settings</h2><button type="button" id="networkRead" class="secondary" disabled>Reload saved settings</button></div>
<p id="networkStatus" class="actual" role="status">Connect USB to read the ESP32 network name, connection status and IP address.</p>
<details id="networkDetails"><summary>Edit saved Wi-Fi and IP settings</summary>
<form id="networkForm" autocomplete="off"><fieldset id="networkEdit" disabled>
<div class="network-grid"><div>
<label>Wi-Fi name (SSID)<input name="ssid" type="text" maxlength="32" required autocomplete="off"></label>
<label><span>Replace saved password</span><input name="replacePassword" type="checkbox"></label>
<label>New password<input name="password" type="password" disabled autocomplete="new-password" placeholder="Existing password is kept"></label>
<label>Show new password<input id="showPassword" type="checkbox"></label>
<small>The stored password is never read back. Select Replace and leave the new password empty only for an open network.</small>
</div><div>
<label>Automatic IP address (DHCP)<input name="dhcp" type="checkbox" checked></label>
<label>Static IP address<input name="ip" type="text" inputmode="decimal" placeholder="192.168.1.100" disabled></label>
<label>Gateway<input name="gateway" type="text" inputmode="decimal" placeholder="192.168.1.1" disabled></label>
<label>Subnet mask<input name="subnet" type="text" inputmode="decimal" placeholder="255.255.255.0" disabled></label>
<label>DNS server<input name="dns" type="text" inputmode="decimal" placeholder="192.168.1.1" disabled></label>
</div></div>
</fieldset><p id="networkFeedback" role="status">Saved on the ESP32 and restored after power-off. Reload replaces pending network edits.</p>
<button type="submit" id="networkSave" disabled>Save &amp; reconnect Wi-Fi</button>
<small>Saving reconnects Wi-Fi without rebooting or changing the outputs. USB stays available even if Wi-Fi cannot connect.</small>
</form></details></section>
<p class="mapping"><strong>Pin mapping:</strong> Pairs: GPIO18/19, GPIO21/22, GPIO23/32. Multifunction outputs: GPIO25/26.</p>
<p id="empty">Channel controls appear here after connecting to your ESP32.</p><div id="channels" class="grid"></div>
<p>All outputs start OFF. Pair frequency 0 disables both sides. At 0% duty the low side is continuously HIGH; at 100% the high side is continuously HIGH when enabled.</p>
<p>Pulse and burst outputs are 3.3 V logic. Analog waveforms use an 8-bit DAC, centered near half the supply voltage; amplitude is a percentage of its nominal full range. The raw DAC is not a calibrated or 50 Ω laboratory output.</p>
<p>Analog modes: requested 10–5000 Hz, rounded in about 9.77 Hz steps, at 40000 samples/second per channel. Waveforms become coarser toward 5000 Hz. Changing one analog channel briefly restarts any other active analog channel.</p>
<p><small>This page controls the ESP32 over USB serial or HTTP over TCP/IP. Closing or disconnecting leaves the last applied output state in place. Use Stop all outputs first if desired.</small></p>
</main><script>
(() => {
'use strict';
// Direct browser USB transport for the existing FG newline/JSON protocol.
class SerialTransport extends EventTarget {
  constructor() {
    super();
    this.port = null;
    this.reader = null;
    this.writer = null;
    this.active = null;
    this.queue = [];
    this.sequence = crypto.getRandomValues(new Uint32Array(1))[0] % 999999999;
    this.closing = false;
  }

  get connected() { return !!this.port && !this.closing; }

  async open(port) {
    if (this.port) throw new Error('A USB connection is already open.');
    this.closing = false;
    try {
      await port.open({baudRate: 115200, bufferSize: 4096, flowControl: 'none'});
      this.port = port;
      // ESP32 USB adapters can reset on open. Initial read-only handshake retries handle boot.
      await port.setSignals({dataTerminalReady: false, requestToSend: false});
      this.writer = port.writable.getWriter();
      this.readTask = this.readLoop(port);
    } catch (error) {
      if (this.port) await this.close();
      throw error;
    }
  }

  request(path, params = {}, timeout = 6000) {
    if (!this.connected) return Promise.reject(new Error('USB is not connected.'));
    return new Promise((resolve, reject) => {
      if (path === '/stop') {
        // Do not allow an older queued Apply to enable an output after Stop.
        const keep = [];
        for (const item of this.queue) {
          if (['/set', '/burst', '/network/set'].includes(item.path)) {
            item.reject(new Error('Queued action cancelled by Stop.'));
          } else keep.push(item);
        }
        this.queue = keep;
      }
      const item = {path, params, timeout, resolve, reject};
      if (path === '/stop') this.queue.unshift(item);
      else this.queue.push(item);
      this.pump();
    });
  }

  pump() {
    if (this.active || !this.queue.length || !this.connected) return;
    const item = this.queue.shift();
    this.sequence = this.sequence % 999999999 + 1;
    const query = new URLSearchParams(item.params).toString();
    const command = new TextEncoder().encode(`FG ${this.sequence} ${item.path}${query ? '?' + query : ''}\n`);
    if (command.byteLength > 1537) {
      item.reject(new Error('Command exceeds the firmware limit of 1536 bytes.'));
      this.pump(); return;
    }
    item.id = this.sequence;
    this.active = item;
    item.timer = setTimeout(() => {
      this.finish(item, new Error('USB request timed out. The command may have been applied; check device status before retrying.'));
    }, item.timeout);
    this.writer.write(command).catch(error => this.finish(item, error));
  }

  finish(item, error, data) {
    if (this.active !== item) return;
    clearTimeout(item.timer);
    this.active = null;
    if (error) item.reject(error);
    else item.resolve(data);
    this.pump();
  }

  async readLoop(port) {
    let buffer = '';
    const decoder = new TextDecoder();
    try {
      this.reader = port.readable.getReader();
      while (!this.closing) {
        const {value, done} = await this.reader.read();
        if (done) break;
        buffer += decoder.decode(value, {stream: true});
        let newline;
        while ((newline = buffer.indexOf('\n')) >= 0) {
          const line = buffer.slice(0, newline).trimEnd();
          buffer = buffer.slice(newline + 1);
          if (!line.startsWith('FG ')) continue;
          let reply;
          try { reply = JSON.parse(line.slice(3)); } catch { continue; }
          const item = this.active;
          if (!item || reply?.id !== item.id) continue; // Ignore stale replies and boot messages.
          if (reply.code !== 200) this.finish(item, new Error(String(reply.data || 'Command rejected.')));
          else if (!Object.hasOwn(reply, 'data')) this.finish(item, new Error('Incomplete firmware response.'));
          else this.finish(item, null, reply.data);
        }
        if (buffer.length > 16384) buffer = '';
      }
    } catch (error) {
      if (!this.closing) this.readError = error;
    } finally {
      this.reader?.releaseLock();
      this.reader = null;
      if (!this.closing) {
        this.dispatchEvent(new Event('disconnect'));
        // Run cleanup after this read task resolves to avoid waiting on itself.
        queueMicrotask(() => this.close());
      }
    }
  }

  async close() {
    if (this.closing) return this.closeTask;
    this.closing = true;
    this.closeTask = this.cleanup();
    return this.closeTask;
  }

  async cleanup() {
    const error = new Error('USB disconnected. An in-flight command may have been applied.');
    if (this.active) this.finish(this.active, error);
    for (const item of this.queue.splice(0)) item.reject(error);
    try { await this.reader?.cancel(); } catch { /* Cable may already be disconnected. */ }
    try { await this.readTask; } catch { /* Reported by readLoop. */ }
    this.writer?.releaseLock();
    this.writer = null;
    try { await this.port?.close(); } catch { /* Device may already be closed. */ }
    this.port = null;
  }
}

// HTTP over TCP/IP. Same request(path, params) contract as SerialTransport.
class HttpTransport extends EventTarget {
  constructor() {
    super();
    this.address = null;
    this.queue = [];
    this.active = null;
  }
  get connected() { return this.address !== null; }
  async open(address) {
    const url = new URL(address.includes('://') ? address : 'http://' + address);
    if (url.protocol !== 'http:' || url.username || url.password || url.pathname !== '/' || url.search || url.hash)
      throw new Error('Enter an HTTP device address, for example http://192.168.1.50');
    this.address = url.origin;
  }
  request(path, params = {}, timeout = 6000) {
    if (!this.connected) return Promise.reject(new Error('HTTP is disconnected.'));
    if (!['/state', '/network', '/set', '/burst', '/stop', '/network/set'].includes(path))
      return Promise.reject(new Error('Unknown command path.'));
    return new Promise((resolve, reject) => {
      if (path === '/stop') {
        const keep = [];
        for (const item of this.queue) {
          if (['/set', '/burst', '/network/set'].includes(item.path)) item.reject(new Error('Queued action cancelled by Stop.'));
          else keep.push(item);
        }
        this.queue = keep;
      }
      const item = {path, params, timeout, resolve, reject};
      if (path === '/stop') this.queue.unshift(item);
      else this.queue.push(item);
      this.pump();
    });
  }
  async pump() {
    if (this.active || !this.queue.length || !this.connected) return;
    const item = this.queue.shift();
    this.active = item;
    item.controller = new AbortController();
    const timer = setTimeout(() => item.controller.abort(), item.timeout);
    try {
      const reading = ['/state', '/network'].includes(item.path);
      const response = await fetch(this.address + item.path, {
        method: reading ? 'GET' : 'POST',
        body: reading ? undefined : new URLSearchParams(item.params),
        cache: 'no-store', signal: item.controller.signal,
      });
      const body = await response.text();
      if (!response.ok) throw new Error(body || 'HTTP ' + response.status);
      if (!this.connected || item.controller.signal.aborted) throw new Error('Connection closed.');
      item.resolve(JSON.parse(body));
    } catch (error) {
      item.reject(new Error(error.name === 'AbortError' || error instanceof TypeError ?
        'HTTP action not confirmed. It may have been applied; check state before retrying. Check address and browser local-network permissions.' : error.message));
    } finally {
      clearTimeout(timer);
      this.active = null;
      this.pump();
    }
  }
  async close() {
    this.address = null;
    this.active?.controller.abort();
    for (const item of this.queue.splice(0)) item.reject(new Error('HTTP disconnected.'));
  }
}

// Channel markup, mode controls and applied-value summaries reused from the ESP32 web page.
const analog=m=>['sine','triangle','rectangle'].includes(m);
function enableSections(form){if(!form.elements.mode)return;const mode=form.elements.mode.value;
for(const section of form.querySelectorAll('[data-section]')){const kind=section.dataset.section;const visible=kind==='timing'?(mode==='pulse'||mode==='burst'):kind==='analog'?analog(mode):mode===kind;section.hidden=!visible;for(const input of section.querySelectorAll('input'))input.disabled=!visible;}
const enable=form.querySelector('[data-enable]');enable.hidden=mode==='burst';form.elements.enabled.disabled=mode==='burst';
const start=form.querySelector('[data-start]');start.hidden=mode!=='burst';start.disabled=form.dataset.appliedMode!=='burst'||form.dataset.dirty==='1';}
function summary(c){if(c.id<3)return (c.duty===0||c.duty===100?'Constant output when enabled':'Applied frequency: '+c.actualHz.toFixed(3)+' Hz')+'<br>Applied duty (before dead time): '+c.actualDuty.toFixed(3)+'%<br>High / low on-time: '+c.highDuty.toFixed(3)+'% / '+c.lowDuty.toFixed(3)+'%<br>Actual dead time: '+c.actualDeadUs.toFixed(3)+' µs';
if(analog(c.mode))return 'Applied mode: '+c.mode+'<br>Nominal actual frequency: '+c.actualWaveHz.toFixed(3)+' Hz<br>Amplitude: '+c.amplitude+'%';
if(c.mode==='burst')return 'Burst frequency: '+c.actualHz.toFixed(3)+' Hz<br>'+c.pulseCount+' pulses × '+c.burstCount+' bursts<br>Completed bursts: '+c.completedBursts;
return 'Actual frequency: '+c.actualHz.toFixed(3)+' Hz<br>Actual duty: '+c.actualDuty.toFixed(3)+'%';}
function channelHTML(c){
const pair=c.id<3;
return `<form data-id="${c.id}" data-applied-mode="${c.mode}"><h2>${pair?'Pair '+(c.id+1):'Waveform '+(c.id-2)} <span class="badge">${c.enabled?'ON':'OFF'}</span></h2><p class="pins">${pair?'High-side: GPIO'+c.highPin+'<br>Low-side: GPIO'+c.lowPin:'Output: GPIO'+c.highPin}</p>
${pair?`<label>Frequency (Hz)<input name="frequency" type="number" min="0" max="100000" step="any" value="${c.frequency}" required></label><small>1–100000 Hz, or 0 to disable</small>
<label>Duty (%)<input name="duty" type="number" min="0" max="100" step="any" value="${c.duty}" required></label><label>Dead time (µs)<input name="deadUs" type="number" min="0" max="1000" step="any" value="${c.deadUs}" required></label>`:
`<label>Output mode<select name="mode">${[['pulse','Continuous pulse'],['burst','Pulse burst'],['sine','Sine (analog)'],['triangle','Triangle (analog)'],['rectangle','Rectangle (analog)']].map(([v,label])=>'<option value="'+v+'" '+(c.mode===v?'selected':'')+'>'+label+'</option>').join('')}</select></label>
<section data-section="timing"><label>On time (µs)<input name="onUs" type="number" min="1" max="30000" step="1" value="${c.onUs}" required></label><label>Off time (µs)<input name="offUs" type="number" min="1" max="30000" step="1" value="${c.offUs}" required></label></section>
<section data-section="burst"><label>Pulses per burst<input name="pulseCount" type="number" min="1" max="255" step="1" value="${c.pulseCount}" required></label><label>Number of bursts<input name="burstCount" type="number" min="1" max="1000" step="1" value="${c.burstCount}" required></label><label>Pause between bursts (ms)<input name="gapMs" type="number" min="0" max="60000" step="1" value="${c.gapMs}" required></label><small>Apply settings, then press Start bursts. Each burst has an exact pulse count; the extra pause is approximate. Example: 10 pulses × 3 bursts = 30 pulses total.</small></section>
<section data-section="analog"><label>Waveform frequency (Hz)<input name="waveHz" type="number" min="10" max="5000" step="any" value="${c.waveHz}" required></label><label>Amplitude (%)<input name="amplitude" type="number" min="0" max="100" step="any" value="${c.amplitude}" required></label></section>`}
<label data-enable>Enable output<input name="enabled" type="checkbox" ${c.enabled?'checked':''}></label><p class="actual">${summary(c)}</p><p class="feedback" role="status"></p><button type="submit">Apply channel</button>
${pair?'':'<button type="button" data-start="'+c.id+'">Start bursts</button>'} <button type="button" class="stop" data-stop="${c.id}">Stop</button></form>`;
}
function render(data){const channels=document.getElementById('channels');channels.innerHTML=data.map(channelHTML).join('');for(const form of channels.querySelectorAll('form'))enableSections(form);}




const $ = id => document.getElementById(id);
const status = $('status'), channels = $('channels'), networkForm = $('networkForm');
let transport = null;
const hosted = window.FG_DEVICE_PAGE === true;
if (hosted) { $('connectionMode').value = 'http'; $('deviceAddress').value = location.origin; }
let connected = false, connecting = false, pending = 0, polling = false;
let connectionRevision = 0, networkRevision = 0, networkLoaded = false;
let lastNetwork = null, pollFailures = 0;
const supported = window.isSecureContext && 'serial' in navigator;

function applyBusyState() {
  const wifi = $('connectionMode').value === 'http';
  $('connect').disabled = (!wifi && !supported) || connected || connecting;
  $('connectionMode').disabled = connected || connecting;
  $('deviceAddress').disabled = connected || connecting;
  $('deviceAddressLabel').hidden = !wifi;
  $('disconnect').disabled = !connected;
  $('stopAll').disabled = !connected;
  $('networkRead').disabled = !connected || pending > 0;
  $('networkEdit').disabled = !connected || !networkLoaded;
  $('networkSave').disabled = !connected || !networkLoaded || pending > 0;
  networkSections();
  for (const form of channels.querySelectorAll('form')) {
    enableSections(form);
    if (!connected) for (const field of form.querySelectorAll('input,select')) field.disabled = true;
    for (const b of form.querySelectorAll('button')) {
      b.disabled = !connected || (!b.hasAttribute('data-stop') && (pending > 0 ||
        (b.hasAttribute('data-start') && (form.dataset.appliedMode !== 'burst' || form.dataset.dirty === '1'))));
    }
  }
  $('connectionBadge').textContent = connected ? ($('connectionMode').value === 'http' ? 'Wi-Fi connected' : 'USB connected') : connecting ? 'Connecting…' : 'Not connected';
  $('connectionBadge').classList.toggle('connected', connected);
}

function networkSections() {
  const f = networkForm.elements;
  f.password.disabled = !f.replacePassword.checked;
  f.password.type = $('showPassword').checked ? 'text' : 'password';
  for (const key of ['ip', 'gateway', 'subnet', 'dns']) {
    f[key].disabled = f.dhcp.checked;
    f[key].required = !f.dhcp.checked;
  }
}

function updateChannels(data, load = null) {
  if (!Array.isArray(data) || data.length !== 5) throw new Error('Unexpected channel response. Update the ESP32 firmware.');
  if (!channels.querySelector('form')) render(data);
  for (const c of data) {
    let form = channels.querySelector(`form[data-id="${c.id}"]`);
    if (!form) throw new Error('Unexpected channel ID.');
    if (load && load.id === String(c.id) && (form.dataset.revision || '0') === load.revision) {
      form.outerHTML = channelHTML(c);
      form = channels.querySelector(`form[data-id="${c.id}"]`);
      form.querySelector('.feedback').textContent = 'Channel settings applied.';
    }
    form.querySelector('.badge').textContent = c.enabled ? 'ON' : 'OFF';
    form.querySelector('.actual').innerHTML = summary(c);
    if (form.dataset.dirty !== '1') form.elements.enabled.checked = c.enabled;
    form.dataset.appliedMode = c.mode;
  }
  $('empty').hidden = true;
  applyBusyState();
}

function updateNetwork(data, load = false) {
  if (!data || typeof data.ssid !== 'string') throw new Error('Unexpected network response. Update the ESP32 firmware.');
  lastNetwork = data;
  $('networkStatus').textContent = `${data.connected ? 'Connected' : 'Not connected'} · ${data.ssid}\n` +
    `Current IP: ${data.currentIP} · ${data.dhcp ? 'DHCP' : 'Static IP'}\n` +
    `Gateway: ${data.currentGateway} · Subnet: ${data.currentSubnet} · DNS: ${data.currentDns}\n` +
    `Saved password: ${data.passwordSet ? 'set (hidden)' : 'none / open network'}`;
  if (load || !networkLoaded) {
    for (const key of ['ssid', 'ip', 'gateway', 'subnet', 'dns']) networkForm.elements[key].value = data[key];
    networkForm.elements.dhcp.checked = data.dhcp;
    networkForm.elements.password.value = '';
    networkForm.elements.replacePassword.checked = false;
    $('showPassword').checked = false;
    networkForm.dataset.dirty = '0';
    $('networkFeedback').textContent = 'Saved settings read from ESP32. The password is hidden.';
    networkLoaded = true;
  }
  applyBusyState();
}

async function connect() {
  if (connected || connecting) return;
  connecting = true;
  const revision = ++connectionRevision;
  applyBusyState();
  status.textContent = $('connectionMode').value === 'http' ? 'Connecting to the ESP32 over HTTP…' : 'Select your ESP32 in the browser USB serial dialog…';
  try {
    // The browser chooser must be called directly from a button click.
    if ($('connectionMode').value === 'http') {
      transport = new HttpTransport();
      await transport.open($('deviceAddress').value);
    } else {
      const port = await navigator.serial.requestPort();
      if (revision !== connectionRevision) return;
      transport = new SerialTransport();
      await transport.open(port);
    }
    transport.addEventListener('disconnect', () => {
      if (connected || connecting) disconnect('Connection lost. Reconnect to read device state.');
    });
    status.textContent = 'Reading ESP32 settings… Waiting for startup if the USB adapter reset the board.';
    let data;
    for (let attempt = 0; attempt < 4; ++attempt) {
      if (revision !== connectionRevision) return;
      try { data = await transport.request('/state', {}, 3000); break; }
      catch (error) {
        if (!error.message.includes('timed out') || attempt === 3) throw error;
      }
    }
    if (revision !== connectionRevision) return;
    const network = await transport.request('/network');
    if (revision !== connectionRevision) return;
    channels.replaceChildren();
    networkLoaded = false;
    connected = true;
    updateChannels(data);
    updateNetwork(network, true);
    pollFailures = 0;
    status.textContent = 'Connected. Displays show applied settings; press Apply after editing.';
  } catch (error) {
    if (revision === connectionRevision) {
      connected = false;
      status.textContent = error.name === 'NotFoundError' ? 'Connection cancelled. Click Connect USB to try again.' : 'Could not connect: ' + error.message;
      await transport?.close();
    }
  } finally {
    if (revision === connectionRevision) { connecting = false; applyBusyState(); }
  }
}

async function disconnect(message = 'Disconnected. Outputs retain their last applied state.') {
  const revision = ++connectionRevision;
  connected = false;
  connecting = true;
  status.textContent = message;
  applyBusyState();
  await transport?.close();
  if (revision === connectionRevision) {
    connecting = false;
    pending = 0;
    applyBusyState();
  }
}

async function action(path, params, options = {}) {
  if (!connected || (pending > 0 && path !== '/stop')) return;
  const revision = connectionRevision;
  pending++;
  applyBusyState();
  const form = options.form;
  const formRevision = form?.dataset.revision || '0';
  const netRevision = networkRevision;
  status.textContent = path === '/set' ? 'Applying channel…' : path === '/burst' ? 'Starting bursts…' :
    path === '/stop' ? 'Stopping outputs…' : path === '/network/set' ? 'Saving Wi-Fi settings…' : 'Reading saved Wi-Fi settings…';
  try {
    const data = await transport.request(path, params);
    if (revision !== connectionRevision) return;
    if (path.startsWith('/network')) {
      updateNetwork(data, netRevision === networkRevision);
      status.textContent = path === '/network/set' ? 'Network settings saved on ESP32. Wi-Fi reconnecting. If its address changes, reconnect using the new address. USB remains available.' : 'Saved Wi-Fi settings read from ESP32.';
      if (path === '/network/set' && netRevision === networkRevision) $('networkFeedback').textContent = 'Saved in ESP32 flash. Wi-Fi reconnecting…';
    } else {
      updateChannels(data, path === '/set' ? {id: form.dataset.id, revision: formRevision} : null);
      status.textContent = path === '/set' ? (params.mode === 'burst' ? 'Burst settings applied. Press Start bursts.' : 'Channel settings applied.') :
        path === '/burst' ? 'Burst sequence started.' : 'Stop confirmed. ' + (params.id === 'all' ? 'All outputs OFF.' : 'Channel OFF.');
    }
  } catch (error) {
    if (revision !== connectionRevision) return;
    status.textContent = 'Action not confirmed: ' + error.message;
    if (form?.isConnected) form.querySelector('.feedback').textContent = status.textContent;
    if (path === '/network/set') $('networkFeedback').textContent = status.textContent;
  } finally {
    if (revision === connectionRevision) pending = Math.max(0, pending - 1);
    applyBusyState();
  }
}

function changed(form) {
  form.dataset.dirty = '1';
  form.dataset.revision = String(Number(form.dataset.revision || 0) + 1);
  form.querySelector('.feedback').textContent = 'Changes not applied. Press Apply channel.';
  applyBusyState();
}
channels.addEventListener('input', e => { if (e.target.form) changed(e.target.form); });
channels.addEventListener('change', e => { if (e.target.form) changed(e.target.form); });
channels.addEventListener('invalid', e => {
  if (e.target.form) e.target.form.querySelector('.feedback').textContent = 'Check the highlighted field: ' + e.target.validationMessage;
}, true);
channels.addEventListener('submit', e => {
  e.preventDefault();
  const form = e.target;
  const params = Object.fromEntries(new FormData(form));
  params.id = form.dataset.id;
  params.enabled = form.elements.enabled.disabled ? '0' : form.elements.enabled.checked ? '1' : '0';
  action('/set', params, {form});
});
channels.addEventListener('click', e => {
  const button = e.target.closest('button');
  if (!button || button.disabled) return;
  if (button.dataset.stop !== undefined) action('/stop', {id: button.dataset.stop});
  if (button.dataset.start !== undefined) action('/burst', {id: button.dataset.start});
});
$('stopAll').onclick = () => action('/stop', {id: 'all'});
$('connect').onclick = connect;
$('disconnect').onclick = () => disconnect();
$('networkRead').onclick = () => action('/network', {});
networkForm.addEventListener('input', networkChanged);
networkForm.addEventListener('change', networkChanged);
function networkChanged() {
  networkRevision++;
  networkForm.dataset.dirty = '1';
  $('networkFeedback').textContent = 'Network changes not saved.';
  networkSections();
}
networkForm.addEventListener('submit', e => {
  e.preventDefault();
  const f = networkForm.elements;
  const params = {ssid: f.ssid.value, dhcp: f.dhcp.checked ? '1' : '0', replacePassword: f.replacePassword.checked ? '1' : '0'};
  if (new TextEncoder().encode(params.ssid).length > 32) {
    $('networkFeedback').textContent = 'SSID is limited to 32 UTF-8 bytes.'; f.ssid.focus(); return;
  }
  if (f.replacePassword.checked) params.password = f.password.value;
  if (!f.dhcp.checked) for (const key of ['ip', 'gateway', 'subnet', 'dns']) params[key] = f[key].value.trim();
  action('/network/set', params);
});

async function pollLoop() {
  if (connected && !pending && !polling) {
    polling = true;
    const revision = connectionRevision;
    try {
      const state = await transport.request('/state');
      if (revision !== connectionRevision) throw new Error('USB session changed.');
      updateChannels(state);
      if (!pending) {
        const network = await transport.request('/network');
        if (revision !== connectionRevision) throw new Error('USB session changed.');
        updateNetwork(network);
      }
      if (pollFailures) status.textContent = 'USB communication restored. Displays show applied settings.';
      pollFailures = 0;
    } catch (error) {
      if (revision === connectionRevision) {
        status.textContent = 'Device status unavailable: ' + error.message;
        if (++pollFailures >= 3) await disconnect('Device is not responding. Check the USB cable and reconnect.');
      }
    } finally { polling = false; }
  }
  setTimeout(pollLoop, 2000);
}
$('unsupported').hidden = supported;
$('connectionMode').onchange = applyBusyState;
applyBusyState();
pollLoop();

if (hosted) connect();

})();
</script></body></html>
)HTML";
